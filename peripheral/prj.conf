## CMakeLists.txt
```
if(NOT DEFINED BLUEJOULE_PLATFORM AND DEFINED ENV{BLUEJOULE_PLATFORM})
  set(BLUEJOULE_PLATFORM "$ENV{BLUEJOULE_PLATFORM}")
endif()
cmake_minimum_required(VERSION 3.20.0)
if(NOT DEFINED BLUEJOULE_PLATFORM)
  message(FATAL_ERROR "Select a platform with build.py or -DBLUEJOULE_PLATFORM=<platform-id>")
endif()
set(PLATFORM_DIR "${CMAKE_CURRENT_SOURCE_DIR}/platforms/${BLUEJOULE_PLATFORM}")
if(NOT EXISTS "${PLATFORM_DIR}/platform.json")
  message(FATAL_ERROR "Unknown BlueJoule platform")
endif()
set(CONF_FILE "${CMAKE_CURRENT_SOURCE_DIR}/prj.conf;${PLATFORM_DIR}/prj.conf")
if(EXISTS "${PLATFORM_DIR}/board.overlay")
  set(DTC_OVERLAY_FILE "${PLATFORM_DIR}/board.overlay")
else()
  set(DTC_OVERLAY_FILE "")
endif()
find_package(Zephyr REQUIRED HINTS $ENV{ZEPHYR_BASE})
project(bluejoule_gatt_peripheral)
target_sources(app PRIVATE src/main.c src/bj_cache_stats.c)
include("${PLATFORM_DIR}/platform.cmake")
```

## Kconfig
```
# WBA55 radio uses IRQ 66, omitted from Zephyr 4.4.1's computed count.
config NUM_IRQS
    int
    default 67 if BOARD_NUCLEO_WBA55CG

source "Kconfig.zephyr"

menu "BlueJoule-GATT options"

config BLUEJOULE_CACHE_STATS
    bool "Enable BlueJoule cache statistics"
    default n
    help
        Enable per-benchmark-cycle cache profiling output.

endmenu
```

## prj.conf
```kconfig
# Shared ordinary GATT benchmark settings.
CONFIG_BT=y
CONFIG_BT_PERIPHERAL=y
CONFIG_BT_DEVICE_NAME="BlueJoule-GATT"
CONFIG_BT_DEVICE_APPEARANCE=0
CONFIG_BT_MAX_CONN=1
CONFIG_BT_AUTO_PHY_UPDATE=n
CONFIG_BT_DATA_LEN_UPDATE=n
CONFIG_BT_SMP=n
CONFIG_BT_SETTINGS=n
CONFIG_BT_GATT_CACHING=n
CONFIG_SERIAL=n
CONFIG_CONSOLE=n
CONFIG_UART_CONSOLE=n
CONFIG_PRINTK=n
CONFIG_LOG=n
CONFIG_BOOT_BANNER=n
CONFIG_PM=y
```

## prj_cache.conf
```kconfig
CONFIG_BLUEJOULE_CACHE_STATS=y

CONFIG_SERIAL=y
CONFIG_CONSOLE=y
CONFIG_PRINTK=y
CONFIG_UART_CONSOLE=y
CONFIG_STDOUT_CONSOLE=y
CONFIG_LOG=n
```

## prj_nrf52.conf
```kconfig
CONFIG_BT_LL_SOFTDEVICE=y
CONFIG_BT_LL_SOFTDEVICE_PERIPHERAL=y
CONFIG_BT_LL_SOFTDEVICE_MULTIROLE=n
```

## prj_ti23.conf
```kconfig
CONFIG_BT=y
CONFIG_BT_PERIPHERAL=y

CONFIG_BT_DEVICE_NAME="BlueJoule-GATT"
CONFIG_BT_DEVICE_APPEARANCE=0

CONFIG_BT_AUTO_PHY_UPDATE=n
CONFIG_BT_CTLR_PHY_2M=n
CONFIG_BT_CTLR_PHY_CODED=n
CONFIG_BT_DATA_LEN_UPDATE=n
CONFIG_BT_SMP=n
CONFIG_BT_SETTINGS=n
CONFIG_BT_GATT_CACHING=n

CONFIG_SERIAL=n
CONFIG_CONSOLE=n
CONFIG_UART_CONSOLE=n
CONFIG_PRINTK=n
CONFIG_LOG=n
```

## boards/nrf54l15dk_nrf54l15_cpuapp.overlay
```dts
/*
 * Power / memory reminders for later benchmark cleanup.
 */

/*
&cpuapp_sram {
    reg = <0x2003c000 DT_SIZE_K(16)>;
    ranges = <0x0 0x2003c000 0x20040000>;
};
*/

&uart20 {
    status = "disabled";
};

/ {
    bjmark0: bjmark0 {
        gpios = <&gpio0 4 GPIO_ACTIVE_HIGH>;
    };

    aliases {
        bjmark0 = &bjmark0;
    };
};
```

## src/main.c
```c
/* main.c - BlueJoule BLE GATT-RW v1 benchmark peripheral */

#include <stdint.h>
#include <stddef.h>
#include <stdbool.h>
#include <errno.h>

#include <zephyr/kernel.h>
#include <zephyr/sys/printk.h>
#include <zephyr/version.h>

#include <zephyr/bluetooth/bluetooth.h>
#include <zephyr/bluetooth/conn.h>
#include <zephyr/bluetooth/gap.h>
#include <zephyr/bluetooth/gatt.h>
#include <zephyr/bluetooth/hci.h>
#include <zephyr/bluetooth/uuid.h>

#include "bj_cache_stats.h"

#if !defined(CONFIG_PRINTK)
#define printk(...)
#endif

#define BJ_PERIOD_MS 1000

#define DEVICE_NAME CONFIG_BT_DEVICE_NAME
#define DEVICE_NAME_LEN (sizeof(DEVICE_NAME) - 1)

#define BT_UUID_BJ_SVC_VAL \
    BT_UUID_128_ENCODE(0x0000b100, 0x0000, 0x1000, 0x8000, 0x00805f9b34fb)

#define BT_UUID_BJ_STATUS_CHR_VAL \
    BT_UUID_128_ENCODE(0x0000b101, 0x0000, 0x1000, 0x8000, 0x00805f9b34fb)

#define BT_UUID_BJ_COMMAND_CHR_VAL \
    BT_UUID_128_ENCODE(0x0000b102, 0x0000, 0x1000, 0x8000, 0x00805f9b34fb)

static struct bt_uuid_128 bj_svc_uuid = BT_UUID_INIT_128(BT_UUID_BJ_SVC_VAL);
static struct bt_uuid_128 bj_status_chr_uuid = BT_UUID_INIT_128(BT_UUID_BJ_STATUS_CHR_VAL);
static struct bt_uuid_128 bj_command_chr_uuid = BT_UUID_INIT_128(BT_UUID_BJ_COMMAND_CHR_VAL);

static uint8_t bj_status_value = 0x80;
static uint8_t bj_command_value;

static bool bj_advertising;
static bool bj_connected;
static uint32_t bj_cycle_count;
static uint32_t bj_conn_count;

static const struct bt_data ad[] = {
    BT_DATA_BYTES(BT_DATA_FLAGS, BT_LE_AD_GENERAL | BT_LE_AD_NO_BREDR),
    BT_DATA_BYTES(BT_DATA_UUID128_ALL, BT_UUID_BJ_SVC_VAL),
};

static const struct bt_data sd[] = {
    BT_DATA(BT_DATA_NAME_COMPLETE, DEVICE_NAME, DEVICE_NAME_LEN),
};


/* Zephyr advertising compatibility:
 * Newer Zephyr/NCS: BT_LE_ADV_OPT_CONN means CONNECTABLE | ONE_TIME.
 * Older Zephyr/TI 3.7: spell that explicitly.
 */
#if defined(ZEPHYR_VERSION_CODE) && (ZEPHYR_VERSION_CODE >= ZEPHYR_VERSION(4, 0, 0))
#define BJ_LE_ADV_OPT_CONN BT_LE_ADV_OPT_CONN
#else
#define BJ_LE_ADV_OPT_CONN (BT_LE_ADV_OPT_CONNECTABLE | BT_LE_ADV_OPT_ONE_TIME)
#endif


/* Advertise on channel 37 only, which makes Nordic Sniffer captures easier. */
static const struct bt_le_adv_param adv_param =

    BT_LE_ADV_PARAM_INIT(BJ_LE_ADV_OPT_CONN |
                         BT_LE_ADV_OPT_DISABLE_CHAN_38 |
                         BT_LE_ADV_OPT_DISABLE_CHAN_39,
                         BT_GAP_ADV_FAST_INT_MIN_1,
                         BT_GAP_ADV_FAST_INT_MAX_1,
                         NULL);

static void bj_cycle_work_handler(struct k_work *work);
K_WORK_DELAYABLE_DEFINE(bj_cycle_work, bj_cycle_work_handler);

static void start_advertising(void)
{
    int err;

    if (bj_connected || bj_advertising) {
        return;
    }

    err = bt_le_adv_start(&adv_param, ad, ARRAY_SIZE(ad), sd, ARRAY_SIZE(sd));
    if (err) {
        if (err != -EALREADY) {
            printk("Advertising failed to start (err %d)\n", err);
        }

        bj_advertising = err == -EALREADY;
        return;
    }

    bj_advertising = true;
    bj_cycle_count++;
}

static void bj_cycle_work_handler(struct k_work *work)
{
    ARG_UNUSED(work);

    start_advertising();
    k_work_schedule(&bj_cycle_work, K_MSEC(BJ_PERIOD_MS));
}

static ssize_t read_status_chr(struct bt_conn *conn,
                               const struct bt_gatt_attr *attr,
                               void *buf,
                               uint16_t len,
                               uint16_t offset)
{
    const uint8_t *value = attr->user_data;

    return bt_gatt_attr_read(conn, attr, buf, len, offset, value, sizeof(*value));
}

static ssize_t write_command_chr(struct bt_conn *conn,
                                 const struct bt_gatt_attr *attr,
                                 const void *buf,
                                 uint16_t len,
                                 uint16_t offset,
                                 uint8_t flags)
{
    if (offset != 0) {
        return BT_GATT_ERR(BT_ATT_ERR_INVALID_OFFSET);
    }

    if (len > 0) {
        bj_command_value = ((const uint8_t *)buf)[0];
        bj_status_value = bj_command_value | 0x80;
    }

    return len;
}

/* The secure build requires an encrypted link for application data.
 * Service and characteristic discovery remain publicly discoverable.
 * CONFIG_BT_SMP_SC_PAIR_ONLY enforces LE Secure Connections pairing.
 */
#if defined(CONFIG_BT_SMP)
#define BJ_STATUS_PERM  BT_GATT_PERM_READ_ENCRYPT
#define BJ_COMMAND_PERM BT_GATT_PERM_WRITE_ENCRYPT
#else
#define BJ_STATUS_PERM  BT_GATT_PERM_READ
#define BJ_COMMAND_PERM BT_GATT_PERM_WRITE
#endif

BT_GATT_SERVICE_DEFINE(bj_svc,
    BT_GATT_PRIMARY_SERVICE(&bj_svc_uuid.uuid),

    BT_GATT_CHARACTERISTIC(&bj_status_chr_uuid.uuid,
                           BT_GATT_CHRC_READ,
                           BJ_STATUS_PERM,
                           read_status_chr, NULL, &bj_status_value),

    BT_GATT_CHARACTERISTIC(&bj_command_chr_uuid.uuid,
                           BT_GATT_CHRC_WRITE | BT_GATT_CHRC_WRITE_WITHOUT_RESP,
                           BJ_COMMAND_PERM,
                           NULL, write_command_chr, NULL),
);

static void connected(struct bt_conn *conn, uint8_t err)
{
    bj_cache_stats_start();    

    if (err) {
        printk("Connection failed, err 0x%02x %s\n", err, bt_hci_err_to_str(err));
        bj_connected = false;
        bj_advertising = false;
        return;
    }

    bj_connected = true;
    bj_advertising = false;
    bj_conn_count++;
}

static void disconnected(struct bt_conn *conn, uint8_t reason)
{
    bj_cache_stats_stop();
    bj_cache_stats_print();

    bj_connected = false;
    bj_advertising = false;
    printk("Disconnected, reason 0x%02x %s, cycle %u, conn %u, command 0x%02x, status 0x%02x\n",
           reason, bt_hci_err_to_str(reason), bj_cycle_count, bj_conn_count,
           bj_command_value, bj_status_value);
}

BT_CONN_CB_DEFINE(conn_callbacks) = {
    .connected = connected,
    .disconnected = disconnected,
};

int main(void)
{
    int err;

    err = bt_enable(NULL);
    if (err) {
        printk("Bluetooth init failed (err %d)\n", err);
        return 0;
    }

    printk("Bluetooth initialized\n");

    printk("BlueJoule-GATT peripheral ready as %s\n", DEVICE_NAME);

    k_work_schedule(&bj_cycle_work, K_NO_WAIT);

    while (1) {
        k_sleep(K_FOREVER);
    }

    return 0;
}
```

## src/bj_cache_stats.c
```c
#include "bj_cache_stats.h"

#include <stdint.h>

#if !defined(CONFIG_BLUEJOULE_CACHE_STATS)

void bj_cache_stats_start(void) {}
void bj_cache_stats_stop(void) {}
void bj_cache_stats_print(void) {}

#else

#include <zephyr/kernel.h>
#include <zephyr/sys/printk.h>
#include <zephyr/sys/sys_io.h>

#if (defined(CONFIG_SOC_NRF54L15_CPUAPP) || \
     defined(CONFIG_SOC_NRF54L10_CPUAPP) || \
     defined(CONFIG_SOC_NRF54L05_CPUAPP) || \
     defined(CONFIG_SOC_SERIES_NRF54LX))

#define NRF54_ICACHE_BASE              0xE0082000u

#define NRF54_ICACHE_PROF_ENABLE       0x414u
#define NRF54_ICACHE_PROF_CLEAR        0x418u
#define NRF54_ICACHE_PROF_HIT          0x41Cu
#define NRF54_ICACHE_PROF_MISS         0x420u
#define NRF54_ICACHE_PROF_LMISS        0x424u
#define NRF54_ICACHE_PROF_READS        0x428u
#define NRF54_ICACHE_PROF_WRITES       0x42Cu

#define NRF54_ICACHE_REG(offset)       (NRF54_ICACHE_BASE + (offset))

static uint32_t bj_cache_read(uint32_t offset)
{
    return sys_read32(NRF54_ICACHE_REG(offset));
}

static void bj_cache_write(uint32_t offset, uint32_t value)
{
    sys_write32(value, NRF54_ICACHE_REG(offset));
}

void bj_cache_stats_start(void)
{
    bj_cache_write(NRF54_ICACHE_PROF_ENABLE, 0);
    bj_cache_write(NRF54_ICACHE_PROF_CLEAR, 1);
    bj_cache_write(NRF54_ICACHE_PROF_CLEAR, 0);
    bj_cache_write(NRF54_ICACHE_PROF_ENABLE, 1);
}

void bj_cache_stats_stop(void)
{
    bj_cache_write(NRF54_ICACHE_PROF_ENABLE, 0);
}

void bj_cache_stats_print(void)
{
    uint32_t reads = bj_cache_read(NRF54_ICACHE_PROF_READS);
    uint32_t writes = bj_cache_read(NRF54_ICACHE_PROF_WRITES);
    uint32_t hit = bj_cache_read(NRF54_ICACHE_PROF_HIT);
    uint32_t miss = bj_cache_read(NRF54_ICACHE_PROF_MISS);
    uint32_t lmiss = bj_cache_read(NRF54_ICACHE_PROF_LMISS);
    uint32_t total = hit + miss;
    uint32_t miss_per_mille = total ? ((miss * 1000u) / total) : 0;

    printk("*** cache stats: reads = %u, writes = %u, hit = %u, miss = %u, lmiss = %u, miss = %u.%u%%\n",
           reads, writes, hit, miss, lmiss,
           miss_per_mille / 10u, miss_per_mille % 10u);
}

#elif (defined(CONFIG_SOC_NRF52832) || \
       defined(CONFIG_SOC_NRF52833) || \
       defined(CONFIG_SOC_SERIES_NRF52X))

#define NRF52_NVMC_BASE                0x4001E000u

#define NRF52_NVMC_ICACHECNF           0x540u
#define NRF52_NVMC_IHIT                0x548u
#define NRF52_NVMC_IMISS               0x54Cu

#define NRF52_NVMC_ICACHECNF_CACHEPROFEN_Msk 0x00000100u

#define NRF52_NVMC_REG(offset)         (NRF52_NVMC_BASE + (offset))

static uint32_t bj_cache_read(uint32_t offset)
{
    return sys_read32(NRF52_NVMC_REG(offset));
}

static void bj_cache_write(uint32_t offset, uint32_t value)
{
    sys_write32(value, NRF52_NVMC_REG(offset));
}

void bj_cache_stats_start(void)
{
    uint32_t icachecnf = bj_cache_read(NRF52_NVMC_ICACHECNF);

    bj_cache_write(NRF52_NVMC_ICACHECNF, icachecnf | NRF52_NVMC_ICACHECNF_CACHEPROFEN_Msk);
    bj_cache_write(NRF52_NVMC_IHIT, 0);
    bj_cache_write(NRF52_NVMC_IMISS, 0);
}

void bj_cache_stats_stop(void)
{
    uint32_t icachecnf = bj_cache_read(NRF52_NVMC_ICACHECNF);

    bj_cache_write(NRF52_NVMC_ICACHECNF, icachecnf & ~NRF52_NVMC_ICACHECNF_CACHEPROFEN_Msk);
}

void bj_cache_stats_print(void)
{
    uint32_t hit = bj_cache_read(NRF52_NVMC_IHIT);
    uint32_t miss = bj_cache_read(NRF52_NVMC_IMISS);
    uint32_t reads = hit + miss;
    uint32_t miss_per_mille = reads ? ((miss * 1000u) / reads) : 0;

    printk("*** cache stats: reads = %u, hit = %u, miss = %u, miss = %u.%u%%\n",
           reads, hit, miss,
           miss_per_mille / 10u, miss_per_mille % 10u);
}

#else

void bj_cache_stats_start(void)
{
}

void bj_cache_stats_stop(void)
{
}

void bj_cache_stats_print(void)
{
    printk("*** no cache stats\n");
}

#endif

#endif
```

## src/bj_cache_stats.h
```c
#ifndef BJ_CACHE_STATS_H
#define BJ_CACHE_STATS_H

void bj_cache_stats_start(void);
void bj_cache_stats_stop(void);
void bj_cache_stats_print(void);

#endif
```
